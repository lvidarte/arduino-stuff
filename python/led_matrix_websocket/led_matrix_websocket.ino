/* vim: set ft=c : */

/**
 *
 */

const int cols[5] = {9, 10, 11, 12, 13};
const int rows[7] = {2, 3, 4, 5, 6, 7, 8};

#define LEN 95

const char charset [LEN][5] = {
    {0x00, 0x00, 0x00, 0x00, 0x00},
    {0x21, 0x08, 0x42, 0x00, 0x80},
    {0x52, 0x80, 0x00, 0x00, 0x00},
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    {0x00, 0x31, 0x51, 0x80, 0x00},
};


void setup() {
    for (int i = 2; i <= 13; i++) {
        pinMode(i, OUTPUT);
    }
    Serial.begin(9600);
}

void draw_char(char *c) {
    int pos = 0;
    for (int row = 0; row < 7; row++) {
        for (int col = 0; col < 5; col++) {
            digitalWrite(cols[col], (c[pos++] == '1' ? LOW: HIGH));
        }
        digitalWrite(rows[row], HIGH);
        delayMicroseconds(500);
        digitalWrite(rows[row], LOW);
    }
}

void fixed_char(const char *c, int times) {
    char buffer[40];
    int pos = 0;
    for (int j = 0; j < 5; j++) {
        for (int i = 0; i < 8; i++) {
            buffer[pos++] = ((c[j] << i) & 0x80 ? '1' : '0');
        }
    }
    for (int i = 0; i < times; i++) {
        draw_char(buffer);
    }
}

void marquee_chars(const char *c1, const char *c2, int times) {

    char buffer[35];
    int pos_0 = 5;
    int offset1 = 0;
    int cpos;
    int cindex;
    int shift;
    char value;

    for (int frame = 0; frame < 6; frame++) {
        int pos = 0;

        for (int i = 0; i < 7; i++) {
            for (int j = 0; j < 5; j++) {
                if (j < pos_0) {
                    cpos = pos + offset1;
                    cindex = cpos / 8;
                    shift = cpos % 8;
                    value = ((c1[cindex] << shift) & 0x80 ? '1' : '0');
                }
                if (j == pos_0) {
                    value = '0';
                }
                if (j > pos_0) {
                    cpos = pos - pos_0 - 1;
                    cindex = cpos / 8;
                    shift = cpos % 8;
                    value = ((c2[cindex] << shift) & 0x80 ? '1' : '0');
                }
                buffer[pos++] = value;
            }
        }
        pos_0--;
        offset1++;

        for (int j = 0; j < times; j++) {
            draw_char(buffer);
        }
    }
}

void loop() {
    char message[66];
    char last_char = ' ';
    int index = 0;
    int is_marquee = 0;

    Serial.print('1');
    while (index < 65 && last_char != '\0') {
        if (Serial.available()) {
            last_char = Serial.read();
            if (index == 0 && last_char == '~') {
                is_marquee = 1;
            } else {
                message[index] = last_char;
                index++;
            }
        }
    }
    Serial.print('0');

    int len_message = strlen(message);

    for (int i = 0; i < 2; i++) {
        for (int j = 0; j < len_message; j++) {

            if (is_marquee) {
                // marquee
                if (i == 1 && j == len_message -1) {
                    break;
                }
                int k1 = (int) message[j] - 32;
                int k2 = (int) message[(j < len_message - 1) ? j + 1 : 0] - 32;
                marquee_chars(charset[k1], charset[k2], 50);
            } else {
                // static, fixed
                int k = (int) message[j] - 32;
                fixed_char(charset[k], 200);
                fixed_char(charset[0], 50); // space
            }

        }
    }

}

