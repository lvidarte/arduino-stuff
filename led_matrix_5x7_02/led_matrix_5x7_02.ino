/* vim: set ft=c : */

/**
 *
 */

const int cols[5] = {9, 10, 11, 12, 13};
const int rows[7] = {2, 3, 4, 5, 6, 7, 8};

#define LEN 91

const char charset [LEN][5] = {
    {0x00, 0x00, 0x00, 0x00, 0x00},
    {0x21, 0x08, 0x42, 0x00, 0x80},
    {0x52, 0x80, 0x00, 0x00, 0x00},
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    {0x00, 0x3e, 0x17, 0x43, 0xe0},
};

void draw(char *c) {
    int pos = 0;
    for (int row = 0; row < 7; row++) {
        for (int col = 0; col < 5; col++) {
            digitalWrite(cols[col], (c[pos++] == '1' ? LOW: HIGH));
        }
        digitalWrite(rows[row], HIGH);
        delayMicroseconds(500);
        digitalWrite(rows[row], LOW);
    }
}

void show(const char *c, int times) {
    char buffer[40];
    int pos = 0;
    for (int j = 0; j < 5; j++) {
        for (int i = 0; i < 8; i++) {
            buffer[pos++] = ((c[j] << i) & 0x80 ? '1' : '0');
        }
    }
    for (int i = 0; i < times; i++) {
        draw(buffer);
    }
}

void marquee(const char *c1, const char *c2, int times) {

    char buffer[35];
    int pos_0 = 5;
    int offset1 = 0;
    int cpos;
    int cindex;
    int shift;
    char value;

    for (int frame = 0; frame < 6; frame++) {
        int pos = 0;

        for (int i = 0; i < 7; i++) {
            for (int j = 0; j < 5; j++) {
                if (j < pos_0) {
                    cpos = pos + offset1;
                    cindex = cpos / 8;
                    shift = cpos % 8;
                    value = ((c1[cindex] << shift) & 0x80 ? '1' : '0');
                }
                if (j == pos_0) {
                    value = '0';
                }
                if (j > pos_0) {
                    cpos = pos - pos_0 - 1;
                    cindex = cpos / 8;
                    shift = cpos % 8;
                    value = ((c2[cindex] << shift) & 0x80 ? '1' : '0');
                }

                buffer[pos++] = value;
            }
        }
        pos_0--;
        offset1++;

        for (int j = 0; j < times; j++) {
            draw(buffer);
        }
    }
}

void setup() {
    for (int i = 2; i <= 13; i++) {
        pinMode(i, OUTPUT);
    }
}

void loop() {
    char msg[] = "Hello world.";
    int len_msg = sizeof(msg) - 1;
    // char by char
    for (int k = 0; k < len_msg; k++) {
        int index = (int) msg[k] - 32;
        show(charset[index], 200);
        show(charset[0], 50); // space
    }
    delay(1000);
    // marquee
    for (int k = 0; k < len_msg; k++) {
        int index1 = (int) msg[k] - 32;
        int index2 = (int) msg[(k < len_msg - 1) ? k + 1 : 0] - 32;
        marquee(charset[index1], charset[index2], 50);
    }
}

